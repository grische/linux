## Documentation/devicetree/bindings/pci/intel,xrx500-pcie.yaml
```yaml
# SPDX-License-Identifier: (GPL-2.0-only OR BSD-2-Clause)
%YAML 1.2
---
$id: http://devicetree.org/schemas/pci/intel,xrx500-pcie.yaml#
$schema: http://devicetree.org/meta-schemas/core.yaml#

title: Intel xRX500 PCIe root complex

maintainers:
  - Grische <github@grische.xyz>

description: |
  One of the three Synopsys DesignWare PCIe 2.0 root complexes of the Intel
  MIPS xRX500 (GRX500) SoC family. The three instances are identical apart
  from their register windows, their interrupts, their gate clock, the serdes
  PHY they drive and the pair of bits they own in the chip-top byte-swap word.

  The controller is driven through the same driver as intel,lgm-pcie but is
  described separately: it has no core reset line of its own, its glue decodes
  the configuration window itself instead of leaving it to generic ECAM, and
  its byte swapping lives outside the controller. The generic snps,dw-pcie
  compatible is deliberately not carried as a fallback, as the DesignWare
  schema asks of new bindings.

  There is no MSI receiver wired up on this family, so legacy interrupts are
  the only ones endpoints can raise and they reach the CPU through
  interrupt-map.

allOf:
  - $ref: /schemas/pci/pci-host-bridge.yaml#
  - $ref: /schemas/pci/snps,dw-pcie-common.yaml#

properties:
  compatible:
    const: intel,xrx500-pcie

  reg:
    items:
      - description: DesignWare core registers, reached over the DBI interface
      - description: configuration space of the devices behind the port
      - description: application logic wrapped around the core

  reg-names:
    items:
      - const: dbi
      - const: config
      - const: app

  interrupts:
    maxItems: 1
    description:
      Aggregate interrupt of the application logic. It reports the controller's
      own events, not the endpoints' legacy interrupts, which have their own
      parent interrupts through interrupt-map.

  interrupt-names:
    items:
      - const: ir

  clocks:
    maxItems: 1
    description: The controller's gate clock.

  phys:
    maxItems: 1

  phy-names:
    const: pcie

  bus-range:
    description:
      Must end at 7. The configuration accessor of this family decodes the
      8 MiB window with three bits of bus number, so bus 8 aliases onto the
      DBI registers.
    items:
      - const: 0
      - const: 7

  max-link-speed:
    maximum: 2

  reset-assert-ms:
    description:
      How long PERST# is held asserted, in milliseconds.
    maximum: 500
    default: 100

  intel,syscon:
    $ref: /schemas/types.yaml#/definitions/phandle-array
    items:
      - items:
          - description: phandle to the chip-top syscon
          - description: >
              byte offset within it of the word that holds the byte-swap
              enables of every root complex
    description:
      Byte swapping is done outside the controller, in one word of the chip-top
      syscon that all three root complexes share. Which two bits of that word
      belong to this one is not derivable from anything else the node carries,
      so intel,inbound-shift and intel,outbound-shift come with it.

  intel,inbound-shift:
    $ref: /schemas/types.yaml#/definitions/uint32
    description:
      Bit position in the byte-swap word of this root complex's inbound
      (device to memory) swapper.
    maximum: 31

  intel,outbound-shift:
    $ref: /schemas/types.yaml#/definitions/uint32
    description:
      Bit position in the byte-swap word of this root complex's outbound
      (CPU to device) swapper.
    maximum: 31

  intel,inbound-swap:
    $ref: /schemas/types.yaml#/definitions/uint32
    description:
      Whether the inbound swapper is enabled. This depends on the endpoint
      behind the port rather than on the SoC, because an endpoint that already
      presents host-endian shared memory must not be swapped a second time.
      The swappers exist for a big-endian CPU and stay off on a little-endian
      kernel whatever this says.
    enum: [0, 1]
    default: 0

  intel,outbound-swap:
    $ref: /schemas/types.yaml#/definitions/uint32
    description:
      Whether the outbound swapper is enabled. See intel,inbound-swap.
    enum: [0, 1]
    default: 0

required:
  - compatible
  - reg
  - reg-names
  - interrupts
  - clocks
  - phys
  - phy-names
  - bus-range
  - reset-gpios
  - "#interrupt-cells"
  - interrupt-map
  - interrupt-map-mask
  - intel,syscon
  - intel,inbound-shift
  - intel,outbound-shift

unevaluatedProperties: false

examples:
  - |
    #include <dt-bindings/clock/intel,grx500-clk.h>
    #include <dt-bindings/gpio/gpio.h>
    #include <dt-bindings/interrupt-controller/mips-gic.h>

    pcie@18900000 {
        compatible = "intel,xrx500-pcie";
        device_type = "pci";
        reg = <0x18900000 0x100000>,
              <0xbb000000 0x800000>,
              <0x18800000 0x100000>;
        reg-names = "dbi", "config", "app";
        #address-cells = <3>;
        #size-cells = <2>;
        bus-range = <0x00 0x07>;
        ranges = <0x02000000 0 0xb8000000 0xb8000000 0 0x03000000>;
        linux,pci-domain = <0>;
        max-link-speed = <2>;

        interrupt-parent = <&gic>;
        interrupts = <GIC_SHARED 152 IRQ_TYPE_LEVEL_HIGH>;
        interrupt-names = "ir";
        #interrupt-cells = <1>;
        interrupt-map-mask = <0 0 0 0x7>;
        interrupt-map = <0 0 0 1 &gic GIC_SHARED 136 IRQ_TYPE_LEVEL_HIGH>,
                        <0 0 0 2 &gic GIC_SHARED 137 IRQ_TYPE_LEVEL_HIGH>,
                        <0 0 0 3 &gic GIC_SHARED 138 IRQ_TYPE_LEVEL_HIGH>,
                        <0 0 0 4 &gic GIC_SHARED 139 IRQ_TYPE_LEVEL_HIGH>;

        clocks = <&cgu GCLK_PCIE0>;
        phys = <&pcie_phy0>;
        phy-names = "pcie";
        reset-gpios = <&gpio0 9 GPIO_ACTIVE_LOW>;

        intel,syscon = <&chiptop 0x4c>;
        intel,inbound-shift = <5>;
        intel,outbound-shift = <4>;
        intel,inbound-swap = <1>;
        intel,outbound-swap = <0>;
    };
```

## Documentation/devicetree/bindings/phy/intel,grx500-pciephy.yaml
```yaml
# SPDX-License-Identifier: (GPL-2.0-only OR BSD-2-Clause)
%YAML 1.2
---
$id: http://devicetree.org/schemas/phy/intel,grx500-pciephy.yaml#
$schema: http://devicetree.org/meta-schemas/core.yaml#

title: Intel GRX500 PCIe slim PHY

maintainers:
  - Grische <github@grische.xyz>

description: |
  The serdes PHY feeding one of the three PCIe root complexes of the Intel
  MIPS xRX500 (GRX500) SoC family. Each root complex has a PHY of its own, and
  the three instances differ only in their register window, their bit in the
  first RCU reset bank, and which of them they are.

  Two register blocks outside the PHY's own window take part. One is the
  chip-top interface mux word, which holds this instance's reference-clock
  gate; unlike the USB PHY's per-controller word, all three instances share
  the same word and are told apart by a bit position inside it. The other is
  the LCPLL and its spread-spectrum generator, which sit in the clock
  generation unit and are shared by every instance, so the programming
  sequence runs once no matter how many PHYs are enabled.

properties:
  compatible:
    const: intel,grx500-pciephy

  reg:
    maxItems: 1

  reg-names:
    items:
      - const: phy

  intel,syscon:
    $ref: /schemas/types.yaml#/definitions/phandle-array
    items:
      - items:
          - description: phandle to the chip-top syscon
          - description: >
              byte offset within it of the interface mux word holding the
              reference-clock gates of all three PHYs
    description:
      The reference-clock gate sits in the chip-top syscon rather than in the
      PHY's own register window. The offset is the same for all three
      instances; intel,phy-id selects the bit.

  intel,cgu-syscon:
    $ref: /schemas/types.yaml#/definitions/phandle
    description:
      Phandle to the clock generation unit, which holds the LCPLL and the
      spread-spectrum generator shared by all three PHYs.

  intel,phy-id:
    $ref: /schemas/types.yaml#/definitions/uint32
    description:
      Which of the three instances this is. It selects the instance's bit in
      the shared interface mux word, and the driver cannot derive it from
      anything else the node carries.
    maximum: 2

  intel,ssc-enable:
    $ref: /schemas/types.yaml#/definitions/uint32
    description:
      Whether spread-spectrum clocking is enabled on the shared LCPLL. It is
      shared, so the first instance to ask for it turns it on for all of them.
    enum: [0, 1]
    default: 0

  resets:
    maxItems: 1

  reset-names:
    items:
      - const: phy

  "#phy-cells":
    const: 0

required:
  - compatible
  - reg
  - intel,syscon
  - intel,cgu-syscon
  - intel,phy-id
  - resets
  - reset-names
  - "#phy-cells"

additionalProperties: false

examples:
  - |
    phy@18500000 {
        compatible = "intel,grx500-pciephy";
        reg = <0x18500000 0x100000>;
        reg-names = "phy";
        #phy-cells = <0>;
        intel,syscon = <&chiptop 0x120>;
        intel,cgu-syscon = <&cgu>;
        intel,phy-id = <0>;
        intel,ssc-enable = <1>;
        resets = <&rcu_reset0 12 12>;
        reset-names = "phy";
    };

  - |
    phy@18a00000 {
        compatible = "intel,grx500-pciephy";
        reg = <0x18a00000 0x100000>;
        reg-names = "phy";
        #phy-cells = <0>;
        intel,syscon = <&chiptop 0x120>;
        intel,cgu-syscon = <&cgu>;
        intel,phy-id = <2>;
        intel,ssc-enable = <1>;
        resets = <&rcu_reset0 10 10>;
        reset-names = "phy";
    };
```

## Documentation/devicetree/bindings/phy/intel,grx500-usb-phy.yaml
```yaml
# SPDX-License-Identifier: (GPL-2.0-only OR BSD-2-Clause)
%YAML 1.2
---
$id: http://devicetree.org/schemas/phy/intel,grx500-usb-phy.yaml#
$schema: http://devicetree.org/meta-schemas/core.yaml#

title: Intel GRX500 USB PHY

maintainers:
  - Grische <github@grische.xyz>

description: |
  The USB PHY feeding one of the two on-chip Synopsys DesignWare USB3
  controllers of the Intel MIPS xRX500 (GRX500) SoC family.

  Each controller has a PHY of its own, and the two instances differ only in
  the values of the properties below: a register window, a gate clock, a bit
  in the second RCU reset bank, and the offset of an AXI configuration word
  in the chip-top syscon.

  The PHY also has an over-current interrupt, which is not described here
  because no board wires over-current detection to the pads that feed it.

properties:
  compatible:
    const: intel,grx500-usb-phy

  reg:
    maxItems: 1

  clocks:
    maxItems: 1
    description: The PHY's gate clock.

  resets:
    maxItems: 1

  reset-names:
    items:
      - const: phy

  intel,syscon:
    $ref: /schemas/types.yaml#/definitions/phandle-array
    items:
      - items:
          - description: phandle to the chip-top syscon
          - description: >
              byte offset within it of the AXI configuration word belonging
              to the controller this PHY feeds
    description:
      The AXI configuration word selects the byte order of each of the DWC3
      core's two AXI master ports. It sits in the chip-top syscon rather
      than in the PHY's own register window, at a different offset per
      controller.

  vbus-supply:
    description:
      Port power for the controller this PHY feeds. Optional, since port
      power is not always software controlled. Both PHYs may name the same
      regulator on a board that switches its ports together.

  intel,invert-tx-polarity:
    type: boolean
    description:
      Invert the polarity of the SuperSpeed transmit pair, for a board that
      routes it crossed.

  intel,invert-rx-polarity:
    type: boolean
    description:
      Invert the polarity of the SuperSpeed receive pair, for a board that
      routes it crossed.

  "#phy-cells":
    const: 0

required:
  - compatible
  - reg
  - clocks
  - resets
  - reset-names
  - intel,syscon
  - "#phy-cells"

additionalProperties: false

examples:
  - |
    #include <dt-bindings/clock/intel,grx500-clk.h>

    phy@1a400000 {
        compatible = "intel,grx500-usb-phy";
        reg = <0x1a400000 0x10000>;
        clocks = <&cgu GCLK_USB0>;
        resets = <&rcu_reset1 4 4>;
        reset-names = "phy";
        intel,syscon = <&chiptop 0x18>;
        vbus-supply = <&usb_vbus>;
        #phy-cells = <0>;
    };

  - |
    #include <dt-bindings/clock/intel,grx500-clk.h>

    phy@1a600000 {
        compatible = "intel,grx500-usb-phy";
        reg = <0x1a600000 0x10000>;
        clocks = <&cgu GCLK_USB1>;
        resets = <&rcu_reset1 5 5>;
        reset-names = "phy";
        intel,syscon = <&chiptop 0x34>;
        vbus-supply = <&usb_vbus>;
        #phy-cells = <0>;
    };
```

## Documentation/devicetree/bindings/rng/avm,shm-rng-seed.txt
```
Shared memory based communication of a random seed from one cpu to a
different cpu with external synchronisation.

Required driver node properties:
  - compatible : Should be "avm,shm-rng-seed"
  - memory-region: phandle to a node of reserved memory (see
    Documentation/devicetree/bindings/reserved-memory/reserved-memory.txt)
    used to store the random seed between writing by the sending cpu
    and reading by the receiving cpu.

Optional driver properties:
  - avm,write : Should be set on the writing side (e.g. the first kernel
                started) and not set on the reading side (e.g. the second
                kernel started)

Optional reserved-memory node properties:
  - compatible : Should be "avm,shm-rng-seed-early" if early loading of the
                 memory seed is desired and the driver was compiled into
                 the kernel.

Example for the second kernel reading the data early:
/ {
	...
	reserved-memory {
		shm_rng_seed_mem: shm-rng-seed-mem@12345678 {
			compatible = "avm,shm-rng-seed-early";
			reg = <0x12345678 0x00001000>;
		}
	}
	...
}

Example for the second kernel reading the data late:
/ {
	...
	reserved-memory {
		shm_rng_seed_mem: shm-rng-seed-mem@12345678 {
			reg = <0x12345678 0x00001000>;
		}
	}
	...
	shm-rng-seed@12345678 {
		compatible = "avm,shm-rng-seed";
		memory-region = <&shm_rng_seed_mem>;
	}
	...
}

Example for the first kernel writing the data:
/ {
	...
	reserved-memory {
		shm_rng_seed_mem: shm-rng-seed-mem@12345678 {
			reg = <0x12345678 0x00001000>;
		}
	}
	...
	shm-rng-seed@12345678 {
		compatible = "avm,shm-rng-seed";
		memory-region = <&shm_rng_seed_mem>;
		avm,write;
	}
	...
}
```

## arch/mips/avm_enh/Kconfig
```kconfig
if MIPS

menu "MIPS specific enhancements"

config AVM_SIMPLE_PROFILING_YIELD
	bool "Enable AVM Simple Profiling based on yield feature"
	depends on AVM_SIMPLE_PROFILING && CPU_MIPS_34K
	default n

config AVM_SIMPLE_PROFILING_YIELD_PCNT
	bool "yield signal source is the MIPS performance counter, otherwise we use a generic timer"
	depends on AVM_SIMPLE_PROFILING_YIELD && AR10
	default y

config BUG_EXTRA_INFO
	bool "Smart BUG-handler with extra bugtable-section"
	depends on AVM_ENHANCED

config AVM_WP
	bool "AVM Watchpoint Handler for MIPS 34Kc/InterAptiv"
	depends on MIPS

endmenu
endif # AVM_KERNEL && MIPS
```
