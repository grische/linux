## arch/mips/configs/grx500_defconfig
```kconfig
CONFIG_INTEL_MIPS=y
CONFIG_MIPS_RAW_APPENDED_DTB=y
CONFIG_CPU_MIPS32_R2=y
CONFIG_SCHED_SMT=y
# CONFIG_MIPS_MT_FPAFF is not set
CONFIG_MIPS_CPS=y
CONFIG_DEFAULT_MMAP_MIN_ADDR=65536
CONFIG_SMP=y
CONFIG_MIPS_MT_SMP=y
CONFIG_INTEL_MIPS_VMB_SMP=y
CONFIG_NR_CPUS=4
CONFIG_HZ_100=y
# CONFIG_SECCOMP is not set
# CONFIG_LOCALVERSION_AUTO is not set
CONFIG_DEFAULT_HOSTNAME="GRX500"
CONFIG_SYSVIPC=y
CONFIG_HIGH_RES_TIMERS=y
CONFIG_LOG_BUF_SHIFT=18
CONFIG_BLK_DEV_INITRD=y
CONFIG_INITRAMFS_SOURCE=""
# CONFIG_RD_GZIP is not set
# CONFIG_RD_BZIP2 is not set
# CONFIG_RD_LZMA is not set
# CONFIG_RD_LZO is not set
# CONFIG_RD_LZ4 is not set
CONFIG_INITRAMFS_COMPRESSION_XZ=y
CONFIG_CC_OPTIMIZE_FOR_SIZE=y
CONFIG_SYSCTL_SYSCALL=y
# CONFIG_FHANDLE is not set
# CONFIG_AIO is not set
CONFIG_EMBEDDED=y
# CONFIG_SLUB_DEBUG is not set
# CONFIG_COMPAT_BRK is not set
CONFIG_MODULES=y
CONFIG_MODULE_UNLOAD=y
CONFIG_MODVERSIONS=y
# CONFIG_LBDAF is not set
# CONFIG_BLK_DEV_BSG is not set
# CONFIG_BLK_DEBUG_FS is not set
# CONFIG_SUSPEND is not set
CONFIG_NET=y
CONFIG_PACKET=y
CONFIG_UNIX=y
CONFIG_INET=y
# CONFIG_INET_XFRM_MODE_TRANSPORT is not set
# CONFIG_INET_XFRM_MODE_TUNNEL is not set
# CONFIG_INET_XFRM_MODE_BEET is not set
CONFIG_IPV6_MULTIPLE_TABLES=y
CONFIG_IPV6_SUBTREES=y
CONFIG_IPV6_MROUTE=y
CONFIG_NETFILTER=y
CONFIG_NF_CONNTRACK=m
CONFIG_NF_CONNTRACK_MARK=y
CONFIG_NETFILTER_XT_MARK=m
CONFIG_NETFILTER_XT_TARGET_LOG=m
CONFIG_NETFILTER_XT_TARGET_TCPMSS=m
CONFIG_NETFILTER_XT_MATCH_COMMENT=m
CONFIG_NETFILTER_XT_MATCH_CONNTRACK=m
CONFIG_NETFILTER_XT_MATCH_LIMIT=m
CONFIG_NETFILTER_XT_MATCH_MAC=m
CONFIG_NETFILTER_XT_MATCH_MULTIPORT=m
CONFIG_NETFILTER_XT_MATCH_STATE=m
CONFIG_NETFILTER_XT_MATCH_TIME=m
CONFIG_NF_CONNTRACK_IPV4=m
CONFIG_IP_NF_IPTABLES=m
CONFIG_IP_NF_FILTER=m
CONFIG_IP_NF_TARGET_REJECT=m
CONFIG_IP_NF_NAT=m
CONFIG_IP_NF_TARGET_MASQUERADE=m
CONFIG_IP_NF_TARGET_REDIRECT=m
CONFIG_IP_NF_MANGLE=m
CONFIG_NF_CONNTRACK_IPV6=m
CONFIG_IP6_NF_IPTABLES=m
CONFIG_IP6_NF_FILTER=m
CONFIG_IP6_NF_TARGET_REJECT=m
CONFIG_IP6_NF_MANGLE=m
CONFIG_ATM=m
CONFIG_ATM_BR2684=m
CONFIG_PCI=y
CONFIG_PCI_MSI=y
CONFIG_PCIE_INTEL_GW=y
CONFIG_BLK_DEV_RAM=y
CONFIG_BLK_DEV_RAM_COUNT=4
CONFIG_BLK_DEV_RAM_SIZE=8192
CONFIG_NETDEVICES=y
CONFIG_INTEL_XRX500_NET=y
CONFIG_INTEL_XRX500_GSWIP_API=y
CONFIG_INPUT=y
CONFIG_INPUT_EVDEV=y
CONFIG_INPUT_KEYBOARD=y
CONFIG_KEYBOARD_GPIO_POLLED=y
# CONFIG_INPUT_MOUSE is not set
# CONFIG_SERIO is not set
# CONFIG_CONSOLE_TRANSLATIONS is not set
# CONFIG_VT_CONSOLE is not set
# CONFIG_LEGACY_PTYS is not set
# CONFIG_DEVMEM is not set
CONFIG_SERIAL_LANTIQ=y
# CONFIG_HW_RANDOM is not set
CONFIG_PINCTRL=y
CONFIG_PINCTRL_EQUILIBRIUM=y
CONFIG_POWER_RESET=y
CONFIG_POWER_RESET_SYSCON=y
# CONFIG_HWMON is not set
CONFIG_WATCHDOG=y
CONFIG_WATCHDOG_SYSFS=y
CONFIG_WATCHDOG_PRETIMEOUT_GOV=y
CONFIG_WATCHDOG_PRETIMEOUT_GOV_NOOP=y
CONFIG_WATCHDOG_PRETIMEOUT_GOV_PANIC=y
CONFIG_WATCHDOG_PRETIMEOUT_DEFAULT_GOV_NOOP=y
CONFIG_INTEL_GRX500_WDT=y
CONFIG_REGULATOR=y
CONFIG_REGULATOR_FIXED_VOLTAGE=y
# CONFIG_VGA_CONSOLE is not set
# CONFIG_HID is not set
CONFIG_USB_SUPPORT=y
CONFIG_USB=y
CONFIG_USB_XHCI_HCD=y
CONFIG_USB_XHCI_PLATFORM=y
CONFIG_USB_DWC3=y
CONFIG_USB_DWC3_HOST=y
CONFIG_NEW_LEDS=y
CONFIG_LEDS_CLASS=y
CONFIG_LEDS_GPIO=y
CONFIG_LEDS_LGM=m
CONFIG_LEDS_TRIGGERS=y
CONFIG_LEDS_TRIGGER_TIMER=y
CONFIG_LEDS_TRIGGER_DEFAULT_ON=y
CONFIG_LEDS_TRIGGER_NETDEV=y
# CONFIG_VIRTIO_MENU is not set
# CONFIG_MIPS_PLATFORM_DEVICES is not set
CONFIG_INTEL_CGU_CLK=y
# CONFIG_IOMMU_SUPPORT is not set
CONFIG_GENERIC_PHY=y
CONFIG_PHY_INTEL_GRX500_PCIE=y
CONFIG_PHY_INTEL_GRX500_USB=y
CONFIG_RESET_CONTROLLER=y
CONFIG_RESET_LANTIQ=y
# CONFIG_MANDATORY_FILE_LOCKING is not set
CONFIG_QUOTA=y
# CONFIG_PRINT_QUOTA_WARNING is not set
CONFIG_AUTOFS4_FS=y
CONFIG_PROC_KCORE=y
# CONFIG_PROC_PAGE_MONITOR is not set
CONFIG_PROC_CHILDREN=y
CONFIG_TMPFS=y
CONFIG_TMPFS_XATTR=y
CONFIG_CONFIGFS_FS=y
CONFIG_SQUASHFS=y
CONFIG_SQUASHFS_XATTR=y
CONFIG_SQUASHFS_LZ4=y
CONFIG_SQUASHFS_LZO=y
CONFIG_SQUASHFS_XZ=y
CONFIG_PSTORE=y
CONFIG_PSTORE_CONSOLE=y
CONFIG_PSTORE_RAM=y
CONFIG_NLS=y
CONFIG_PRINTK_TIME=y
CONFIG_BOOT_PRINTK_DELAY=y
CONFIG_DEBUG_INFO=y
# CONFIG_ENABLE_WARN_DEPRECATED is not set
CONFIG_FRAME_WARN=2048
CONFIG_STRIP_ASM_SYMS=y
CONFIG_UNUSED_SYMBOLS=y
CONFIG_DEBUG_FS=y
CONFIG_HEADERS_CHECK=y
CONFIG_MAGIC_SYSRQ=y
# CONFIG_SCHED_DEBUG is not set
CONFIG_DEBUG_RT_MUTEXES=y
CONFIG_DEBUG_ATOMIC_SLEEP=y
# CONFIG_RCU_TRACE is not set
# CONFIG_FTRACE is not set
# CONFIG_RUNTIME_TESTING_MENU is not set
CONFIG_CRYPTO_CCM=y
CONFIG_CRYPTO_GCM=y
# CONFIG_CRYPTO_ECHAINIV is not set
CONFIG_CRYPTO_ARC4=y
CONFIG_CRYPTO_LZO=y
# CONFIG_CRYPTO_HW is not set
CONFIG_CRC_CCITT=y
CONFIG_CRC16=y
CONFIG_CRC_T10DIF=y
CONFIG_LIBCRC32C=y
CONFIG_IRQ_POLL=y
```

## arch/mips/intel-mips/Kconfig
```kconfig
# SPDX-License-Identifier: GPL-2.0-only
if INTEL_MIPS

config INTEL_MIPS_VMB_SMP
	bool "Firmware mailbox CPU launch (VMB)"
	depends on SMP
	default y
	help
	  Bring up the secondary VPEs the way the boot loader on this SoC
	  expects. All four are already running when Linux is entered; the
	  resident loader parks the three it is not using and releases one on
	  request, through a mailbox at the bottom of RAM and a doorbell
	  interrupt. Neither the Coherence Manager nor the Cluster Power
	  Controller is touched, which is what makes this different from
	  MIPS_CPS and why MIPS_CPS cannot start these CPUs.

	  This needs MIPS_MT_SMP to be enabled as well, and says so at boot if
	  it is not. Without it the kernel cannot tell the two VPEs of a core
	  apart, and the interrupt controller misroutes everything aimed at
	  the odd one.

	  Say Y unless you are booting this SoC from something other than the
	  vendor boot chain.

endif
```

## arch/mips/lantiq/Kconfig.grx5
```kconfig
if GRX5 || SOC_TYPE_GRX500_TEP # == SOC_GRX500 (?)

menu "GRX5 Boards"
	choice
		prompt "Board Type"

	config GRX5_AVM_FRITZ_BOX
		bool "AVM Fritz Box with GRX5"

	config PRX_AVM_FRITZ_BOX
		bool "AVM Fritz Box with PRX"

	endchoice
endmenu

endif
```

## avm/kconfig/generated/Kconfig.kgw
```kconfig
# SPDX-License-Identifier: GPL-2.0-only

config KGW_KCONFIG
	def_bool y

if KGW_KCONFIG
menu "AVM kernel/GU wrapper (k/gw) settings"

comment "Kernel/GU wrapper (k/gw) is AVM build system integration for kbuild."
comment "All these settings _do not_ influence the actual kernel build, but are evaluated later (e.g. during FIT image composition)."

config AVM_BOOTLOADER_SUPPORTS_64BIT
	bool "AVM boot loader supports 64bit addresses"
	depends on 64BIT
	default y
	help
	  Some old AVM boot loaders are not able to handle 64bit addresses in
	  FIT images properly.  Set to 'n' to prevent enforcement of 32bit to
	  64bit address extension in AVM FIT compilation scripts.

endmenu
endif
```

## drivers/char/avm_net_trace/Kconfig
```kconfig
#
# AVM_NET_TRACE
#
#

config AVM_NET_TRACE
	bool "AVM net trace"
	default y
	help
	  This driver provides tracing of network packets in pcap format.
```

## drivers/char/avm_new/Documentation/devicetree/bindings/firmware/avm/avm,dt-urlader-env.txt
```
AVM urlader environment stored in the device tree and exposed via
/proc/sys/urlader/environment.

Required properties:
 - compatible            : "avm,dt-urlader-env"
 - avm,urlader-env-names : Whitelist of environment variables to expose
                           if they are stored in the device tree under
                           /chosen/${name}

Example:
	dt-urlader-env {
		compatible = "avm,dt-urlader-env";

		avm,urlader-env-names = "HWRevision", "HWSubRevision", "annex",
					"bootloaderVersion", "maca", "macb",
					"macdsl", "gpon_serial";
	};
```

## drivers/char/avm_new/Documentation/devicetree/bindings/misc/avm,companion-panic.yaml
```yaml
# SPDX-License-Identifier: (GPL-2.0-only OR BSD-2-Clause)
%YAML 1.2
---

$id: http://devicetree.org/schemas/avm,gpio-panic-trigger.yaml#
$schema: http://devicetree.org/meta-schemas/core.yaml#

title: Device-Tree bindings for GPIO synchronized panics on multiple CPUs

maintainers:
  - Johannes Nixdorf <j.nixdorf@avm.de>

properties:
  compatible:
    const: avm,companion-panic

  in-gpio:
    description: The GPIO that will trigger a local panic
    maxItems: 1

  out-gpio:
    description: The GPIO that will set to 1 on a local panic
    maxItems: 1

  avm,sync:
    description: The timeout to wait for the other CPU to panic as well before
      resetting. Disabled if missing or 0.
    $ref: /schemas/types.yaml#/definitions/uint32

  avm,default-disabled:
    description: Whether the panic trigger starts disabled, and only gets
      enabled by writing 1 to the enabled device property.
    type: boolean

required:
  - compatible
  - in-gpio
  - out-gpio

additionalProperties: false

examples:
  - |
    companion-panic {
        compatible = "avm,companion-panic";

        in-gpio = <&tlmm 13 GPIO_ACTIVE_HIGH>; /* fm_panic */
        out-gpio = <&tlmm 11 GPIO_ACTIVE_HIGH>; /* hk_panic */

        avm,sync = <5000>;
        avm,default-disabled;
    };
```

## drivers/char/avm_new/Kconfig
```kconfig
#
# AVM general functions
#
#
menu "AVM Sammeltreiber"

config AVM_SAMMEL
	bool "AVM general support (Event, Watchdog, Debug, Profiling)"
	default y
	help
	  This driver provides general functions for AVMs own drivers.

	  To compile this driver as a module, choose M here. The module
	  will be called avm.

config AVM_EVENT
	bool "AVM event support"
	depends on AVM_SAMMEL
	default y
	help
	  This driver provides support for event handling.

config AVM_EVENT_20
	bool "AVM event support Version 2.0"
	depends on AVM_EVENT
	default y
	help
	  This driver provides support for event handling.

config AVM_PWM
	bool "AVM pwm support"
	depends on AVM_SAMMEL
	default n
	help
	  This driver enables PWM support for LEDs.

config AVM_EVENTNODE_PUMA6
	bool "Remote AVM events on Puma6"
	depends on AVM_EVENT_20 && (MACH_PUMA6 || ARCH_GEN3)
	default n
	help
		This driver enables distribution of AVM events between Atom and ARM core on Puma6.

config AVM_EVENTNODE_PUMA7
	bool "Remote AVM events on Puma7"
	depends on AVM_EVENT_20 && (MACH_PUMA7)
	default n
	help
		This driver enables distribution of AVM events between Atom and ARM core on Puma7.

config AVM_WATCHDOG
	bool "Watchdog support"
	depends on AVM_SAMMEL
	default n
	help
	  This driver provides the watchdog support.

config AVM_WATCHDOG_SHIM
	bool "Watchdog driver shim for standard watchdog drivers"
	depends on AVM_WATCHDOG && AVM_WATCHDOG_SHIM_SUPPORT
	help
	  This watchdog sub-driver adds support for attaching the AVM ar7
	  watchdog driver to any standard watchdog device driver supported by
	  the watchdog core.

config AVM_WATCHDOG_SHIM_LOCKUP_PANIC
	bool "Panic on lockups"
	default y
	depends on AVM_WATCHDOG_SHIM
	help
	  Panic when the watchdog shim driver detects a lockup.  The driver
	  will trigger backtraces on all cpus before doing so.

	  Say Y here unless the kernel does the backtracing on its own, e.g.
	  when the machine dies.

config AVM_LOCKUP_DETECTOR
	bool "NMI timer based lockup detector"
	depends on AVM_WATCHDOG_SHIM
	help
	  Let the shim driver do lockup detection in the NMI handler, assuming
	  the NMI is triggered periodically.

	  Enable this if the watchdog device on the system does not support
	  triggering an NMI, but an NMI-capable timer is available. It is up
	  to the platform kernel to setup such a timer.

if AVM_WATCHDOG && !AVM_WATCHDOG_SHIM
config AVM_WATCHDOG_GRX500
	def_bool y
	depends on LANTIQ && SOC_GRX500
config AVM_WATCHDOG_IFXMIPS
	def_bool y
	depends on LANTIQ && !SOC_GRX500
endif

config AVM_DEBUG
	bool "support for AVM Debug"
	depends on AVM_SAMMEL
	default y

config AVM_DEBUG_BUF_SHIFT
    int "debug log buffer size (16 => 64KB, 17 => 128KB)"
    range 16 25
    default 19
    depends on AVM_DEBUG
    help
      Selects the debug buffer size

config AVM_DEBUG_CONSOLE
	bool "support for AVM Debug console"
	depends on AVM_DEBUG
	default n
	help
	  Implements the console bending via a console driver and
	  CON_MUTED (avm-only) support.

config AVM_LED_EVENTS
	bool "support for AVM Led event based version"
	depends on AVM_SAMMEL
	default n

config AVM_SIMPLE_PROFILING
	bool "Simple Kernel-Profiler"
	depends on AVM_SAMMEL
	select PERF_EVENTS
	select AVM_PROM_ENVIRONMENT
	default y
	help
      Use cat cat /proc/avm/profile/help to get more information.

config ENABLE_SKB_PROFILING_HOOKS
	bool "Enable SKB-Profiling"
	depends on AVM_SIMPLE_PROFILING
	default n

config ENABLE_SPINLOCK_PROFILING_HOOKS
	bool "Enable Spinlock-Profiling"
	depends on AVM_SIMPLE_PROFILING
	default n

config ENABLE_IRQ_PROFILING_HOOKS
	bool "Enable IrqEnable/Disable-Profiling"
	depends on AVM_SIMPLE_PROFILING
	default n

config AVM_PAGE_TRACE
	bool "Enhanced Page-Tracing"
	depends on AVM_SAMMEL
	default y
	help
      get summary of information about page-using

config AVM_NET_EVENT
        bool "AVM Network Event Source"
	depends on AVM_EVENT || AVM_LED_EVENTS || AVM_POWER
	depends on AVM_KERNEL
	select AVM_PROM_ENVIRONMENT
	default n
	help
            generic event source (hardware independent) for AVM_EVENT, AVM_LED and AVM_POWER
            generic ethernet port handler for AVM_POWER. This driver relays on ethtool_ops.

config AVM_KPI
        bool "KPI Subsystem"
	depends on AVM_SAMMEL
	depends on SYSFS
	default y
	help
	    This allows creating key performance indicators from kernel
	    space. They are exposed at /sys/kernel/kpi. Consult
	    include/linux/avm_kpi.h for usage information.

config AVM_FW_INFO
	bool "AVM FW Info"
	default n
	help
	    This enables the API to retrieve information about the firmware inside the kernel.
	    Usually this information contains the firmware version and the required module sizes.
	    Multiple backends exists to provide this information, currently a legacy embedded and
	    a devicetree based variant exists.

config AVM_FW_INFO_EMBED
	bool "Embedded FW info"
	depends on AVM_FW_INFO
	help
	    Allows to retrieve the firmware information from a patched kernel section.

	    A patched kernel contains a special linker section. During the firmware build the
	    kernel will be relinked with this section provided. The maximum size of this section
	    must be defined during build time.

config AVM_FW_INFO_EMBED_DTB
	bool "Embedded FW info may contain DT"
	depends on AVM_FW_INFO_EMBED
	default n
	help
	    Use the devicetree contained in the firmware info.

	    On older platforms the Urlader does not pass the dt directly to the kernel. Instead
	    it edits the device trees embedded in the kernel and the kernel uses these.
	    The correct devicetree is always the dt at index 0 regardless of the actual subrev.

config AVM_FW_INFO_DT
	bool "DeviceTree FW info"
	depends on AVM_FW_INFO
	depends on OF
	default n
	help
	    Allows to retrieve the firmware information from the device tree.

	    Devicetrees may contain a "avm,fw-info" section describing the firmware version and
	    the required module sizes. It can (obviously) not contain another devicetree. This
	    is the preferred method for new kernels.

config AVM_MODULE_MEM
	bool "AVM Module Memory"
	select AVM_FW_INFO
	default n
	help
	    Provides an allocator for module memory which avoids fragmentation and is RTE hard.

	    On low-end platforms (ram <= 64mb) fragmentation is a big concern and fragmentation
	    quickly prohibits the allocation of contiguous memory for modules. The subsequent
	    vmalloc-allocation however has a very negative performance impacts on MIPS platforms.

	    Secondly on platforms employing RTE modules are prohibited from generating tlb-misses
	    and must therefore reside in physical memory and can not be vmapped.

config AVM_PROMCONFIG_FORCE_WORDALIGNED_ACCESS
	bool "Word-align all prom config flash access"
	depends on AVM_SAMMEL
	default y
	help
	    Force word-alignment for all reads of the prom-config flash area.
	    You should not need this on new F!Boxen.

endmenu
```
