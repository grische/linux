## Documentation/devicetree/bindings/gpio/avm,avm_gpio_generic.txt
```
avm_gpio-API using the gpiolib

This is a pseudo-device that takes an GPIO and allows its use via the avm_gpio
API.

Required properties:
- compatible:		"avm,avm_generic_gpio"
- gpio:			The GPIO to expose via the avm_gpio API.

Exactly one of these properties is required:
- avm,input:		Initialize the GPIO as an input.
- avm,output:		Initialize the GPIO as an output.

Optional properties:
- pinctrl-*:		pinctrl-Properties as usual. The driver will try to map
			the avm_gpio FUNCTION_PINMUX1, FUNCTION_PINMUX2 and
			FUNCTION_PINMUX3 to the the pinctrl-states "mux1",
			"mux2" and "mux3" accordingly.

Examples of avm_gpio nodes:
	gpio_avm_button_dect {
		compatible = "avm,avm_gpio_generic";
		gpio = <&gpio1 0 GPIO_ACTIVE_HIGH>;
		avm,input;
	};

	gpio_avm_pcmlink_dcl {
		compatible = "avm,avm_gpio_generic";
		gpio = <&gpio0 31 GPIO_ACTIVE_HIGH>;
		avm,output;
		pinctrl-names = "mux3";
		pinctrl-0 = <&pinctrl_tdm_dcl>;
	};
```

## Documentation/devicetree/bindings/gpio/avm,avm_gpio_led.txt
```
avm_gpio-API using the led subsystem

This provides an led trigger, that is controlled by the avm_gpio functions.

Required properties:
- compatible:		"avm,avm_gpio_led"

Example of an avm_gpio node:
	gpio_avm_led_power {
		compatible = "avm,avm_gpio_led";
	};
```

## Documentation/devicetree/bindings/net/dsa/lantiq,gswip.yaml
```yaml
# SPDX-License-Identifier: (GPL-2.0-only OR BSD-2-Clause)
%YAML 1.2
---
$id: http://devicetree.org/schemas/net/dsa/lantiq,gswip.yaml#
$schema: http://devicetree.org/meta-schemas/core.yaml#

title: Lantiq GSWIP Ethernet switches

description:
  The GSWIP switch macro is embedded in Lantiq and Intel SoCs. The GSWIP-2.x
  models place the MDIO master and the MII port configuration in register
  regions of their own, next to the switch core. GSWIP-3.0 keeps the same
  switch core at the same offsets and moves those functions, along with the
  packet MAC that faces the SoC's queue manager, into the switch's own
  register window, so one region describes the whole macro.

maintainers:
  - Hauke Mehrtens <hauke@hauke-m.de>

properties:
  compatible:
    enum:
      - lantiq,xrx200-gswip
      - lantiq,xrx300-gswip
      - lantiq,xrx330-gswip
      - lantiq,xrx500-gswip
      - lantiq,xrx500-gswip-r

  reg:
    minItems: 1
    maxItems: 3

  reg-names:
    items:
      - const: switch
      - const: mdio
      - const: mii

  dma-noncoherent: true

  interrupts:
    maxItems: 1
    description:
      The macro's aggregated interrupt, raised by the buffer manager, the
      parser and classification engine, the MAC block and the store and
      fetch DMA blocks.

  clocks:
    items:
      - description: switch core clock
      - description: switch core gate

  clock-names:
    items:
      - const: freq
      - const: gate

  mdio:
    $ref: /schemas/net/mdio.yaml#
    unevaluatedProperties: false

    properties:
      compatible:
        const: lantiq,xrx200-mdio

  gphy-fw:
    type: object
    properties:
      '#address-cells':
        const: 1

      '#size-cells':
        const: 0

      compatible:
        oneOf:
          - items:
              - enum:
                  - lantiq,xrx200-gphy-fw
                  - lantiq,xrx300-gphy-fw
                  - lantiq,xrx330-gphy-fw
              - const: lantiq,gphy-fw
          - const: lantiq,xrx500-gphy-fw

      lantiq,rcu:
        $ref: /schemas/types.yaml#/definitions/phandle
        description: phandle to the RCU syscon

      firmware-name:
        maxItems: 1
        description:
          Image the integrated PHYs run, where the loader takes the name from
          the device tree rather than from its own compatible.

    patternProperties:
      "^gphy@[0-9a-f]{1,3}$":
        type: object

        additionalProperties: false

        properties:
          reg:
            minimum: 0
            description:
              Offset of this PHY's firmware address register in the window
              the loader's compatible names.

          resets:
            items:
              - description: GPHY reset line

          reset-names:
            items:
              - const: gphy

        required:
          - reg

    required:
      - compatible

    additionalProperties: false

required:
  - compatible
  - reg

allOf:
  - $ref: dsa.yaml#/$defs/ethernet-ports

  # The GSWIP-2.x models: three regions, an MDIO bus that is a device of its
  # own, and the firmware address registers of the integrated PHYs in the
  # reset control unit.
  - if:
      properties:
        compatible:
          contains:
            enum:
              - lantiq,xrx200-gswip
              - lantiq,xrx300-gswip
              - lantiq,xrx330-gswip
    then:
      properties:
        reg:
          minItems: 3

        mdio:
          required:
            - compatible

        gphy-fw:
          patternProperties:
            "^gphy@[0-9a-f]{1,3}$":
              properties:
                reg:
                  maximum: 255

          required:
            - lantiq,rcu

  # GSWIP-3.0: one region covering the switch core, the macro's top block and
  # the packet MAC. The MDIO bus and the firmware loader reach their registers
  # through that region, so neither is a device of its own and neither takes a
  # region or a syscon of its own.
  - if:
      properties:
        compatible:
          contains:
            enum:
              - lantiq,xrx500-gswip
              - lantiq,xrx500-gswip-r
    then:
      properties:
        reg:
          maxItems: 1

        reg-names: false

        mdio:
          properties:
            compatible: false

        gphy-fw:
          properties:
            lantiq,rcu: false

          patternProperties:
            "^gphy@[0-9a-f]{1,3}$":
              properties:
                reg:
                  maximum: 4095

          required:
            - firmware-name

      required:
        - dma-noncoherent
        - clocks
        - clock-names

  - if:
      not:
        properties:
          compatible:
            contains:
              enum:
                - lantiq,xrx200-gswip
                - lantiq,xrx300-gswip
                - lantiq,xrx330-gswip
                - lantiq,xrx500-gswip
                - lantiq,xrx500-gswip-r
    then:
      properties:
        reg:
          maxItems: 1

        reg-names: false
        gphy-fw: false

unevaluatedProperties: false

examples:
  - |
    switch@e108000 {
            compatible = "lantiq,xrx200-gswip";
            reg = <0xe108000 0x3100>,  /* switch */
                  <0xe10b100 0xd8>,    /* mdio */
                  <0xe10b1d8 0x130>;   /* mii */
            dsa,member = <0 0>;

            ports {
                    #address-cells = <1>;
                    #size-cells = <0>;

                    port@0 {
                            reg = <0>;
                            label = "lan3";
                            phy-mode = "rgmii";
                            phy-handle = <&phy0>;
                    };

                    port@1 {
                            reg = <1>;
                            label = "lan4";
                            phy-mode = "rgmii";
                            phy-handle = <&phy1>;
                    };

                    port@2 {
                            reg = <2>;
                            label = "lan2";
                            phy-mode = "internal";
                            phy-handle = <&phy11>;
                    };

                    port@4 {
                            reg = <4>;
                            label = "lan1";
                            phy-mode = "internal";
                            phy-handle = <&phy13>;
                    };

                    port@5 {
                            reg = <5>;
                            label = "wan";
                            phy-mode = "rgmii";
                            phy-handle = <&phy5>;
                    };

                    port@6 {
                            reg = <0x6>;
                            phy-mode = "internal";
                            ethernet = <&eth0>;

                            fixed-link {
                                    speed = <1000>;
                                    full-duplex;
                            };
                    };
            };

            mdio {
                    #address-cells = <1>;
                    #size-cells = <0>;
                    compatible = "lantiq,xrx200-mdio";

                    phy0: ethernet-phy@0 {
                            reg = <0x0>;
                    };
                    phy1: ethernet-phy@1 {
                            reg = <0x1>;
                    };
                    phy5: ethernet-phy@5 {
                            reg = <0x5>;
                    };
                    phy11: ethernet-phy@11 {
                            reg = <0x11>;
                    };
                    phy13: ethernet-phy@13 {
                            reg = <0x13>;
                    };
            };

            gphy-fw {
                    #address-cells = <1>;
                    #size-cells = <0>;
                    compatible = "lantiq,xrx200-gphy-fw", "lantiq,gphy-fw";
                    lantiq,rcu = <&rcu0>;

                    gphy@20 {
                            reg = <0x20>;

                            resets = <&reset0 31 30>;
                            reset-names = "gphy";
                    };

                    gphy@68 {
                            reg = <0x68>;

                            resets = <&reset0 29 28>;
                            reset-names = "gphy";
                    };
            };
    };

  - |
    switch@1c000000 {
            compatible = "lantiq,xrx500-gswip";
            reg = <0x1c000000 0x4000>;
            interrupt-parent = <&gic>;
            interrupts = <0 48 4>;
            clocks = <&cgu 22>, <&cgu 125>;
            clock-names = "freq", "gate";
            dsa,member = <0 0>;
            dma-noncoherent;

            ports {
                    #address-cells = <1>;
                    #size-cells = <0>;

                    port@0 {
                            reg = <0>;
                            phy-mode = "internal";
                            ethernet = <&conduit>;

                            fixed-link {
                                    speed = <1000>;
                                    full-duplex;
                            };
                    };

                    port@5 {
                            reg = <5>;
                            label = "lan1";
                            phy-mode = "internal";
                            phy-handle = <&gphy5>;
                    };
            };

            mdio {
                    #address-cells = <1>;
                    #size-cells = <0>;

                    gphy5: ethernet-phy@5 {
                            reg = <5>;
                    };
            };

            gphy-fw {
                    #address-cells = <1>;
                    #size-cells = <0>;
                    compatible = "lantiq,xrx500-gphy-fw";
                    firmware-name = "lantiq/xrx500-phy-fw.bin";

                    gphy@f96 {
                            reg = <0xf96>;

                            resets = <&rcu_reset0 25 25>;
                            reset-names = "gphy";
                    };
            };
    };
```

## Documentation/devicetree/bindings/net/lantiq,xrx500-dma.yaml
```yaml
# SPDX-License-Identifier: (GPL-2.0-only OR BSD-2-Clause)
%YAML 1.2
---
$id: http://devicetree.org/schemas/net/lantiq,xrx500-dma.yaml#
$schema: http://devicetree.org/meta-schemas/core.yaml#

title: Intel xRX500 packet DMA controller

maintainers:
  - Grische <github@grische.xyz>

description: |
  One of the four packet DMA controllers of the Intel MIPS xRX500 (GRX500)
  SoC family. Each carries one direction of one GSWIP-3.0 switch macro's
  traffic, and its channels are hard-bound: a transmit channel is tied to a
  dequeue port of the packet buffer manager and fetches its descriptors from
  the window the manager stages them in, and a receive channel writes into a
  ring in memory. The controller offers nothing to arbitrary consumers, so it
  is not a dmaengine provider and has no channel cells; a driver reaches it
  through the phandle of the endpoint that uses it.

  Everything else about a controller -- its arbitration mode, bus burst
  length, channel polling interval, descriptor placement and prefetch, and
  the endianness of the descriptors it fetches -- is fixed for each of the
  four instances by how the SoC wires it up, and belongs to the driver rather
  than to the device tree.

properties:
  compatible:
    const: lantiq,xrx500-dma

  reg:
    maxItems: 1

  interrupts:
    maxItems: 1
    description:
      Aggregate interrupt of the controller. A channel's own completion
      interrupt is reported through it, and the driver reads the pending
      channel from the controller's registers.

required:
  - compatible
  - reg
  - interrupts

additionalProperties: false

examples:
  - |
    #include <dt-bindings/interrupt-controller/irq.h>
    #include <dt-bindings/interrupt-controller/mips-gic.h>

    dma@1c100000 {
            compatible = "lantiq,xrx500-dma";
            reg = <0x1c100000 0x10000>;
            interrupt-parent = <&gic>;
            interrupts = <GIC_SHARED 67 IRQ_TYPE_LEVEL_HIGH>;
    };
```
