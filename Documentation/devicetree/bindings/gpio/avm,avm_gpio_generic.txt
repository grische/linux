## drivers/char/avm_new/event/Kconfig
```kconfig
config AVM_EVENT
	bool "AVM event support"
	depends on AVM_SAMMEL
	default y
	help
	  This driver provides support for event handling.

if AVM_EVENT

config AVM_EVENT_20
	bool "AVM event support Version 2.0"
	default y
	help
	  This driver provides support for event handling.

config AVM_EVENTNODE_PUMA7
	bool "Remote AVM events on Puma7"
	depends on AVM_EVENT_20 && (MACH_PUMA7)
	default n
	help
		This driver enables distribution of AVM events between Atom and ARM core on Puma7.

endif
```

## drivers/char/avm_new/profiling/Kconfig
```kconfig
config AVM_SIMPLE_PROFILING
	bool "Simple Kernel-Profiler"
	depends on AVM_SAMMEL
	select PERF_EVENTS
	select AVM_PROM_ENVIRONMENT
	default y
	help
      Use cat cat /proc/avm/profile/help to get more information.

if AVM_SIMPLE_PROFILING

config ENABLE_SKB_PROFILING_HOOKS
	bool "Enable SKB-Profiling"
	default n

config ENABLE_SPINLOCK_PROFILING_HOOKS
	bool "Enable Spinlock-Profiling"
	default n

config ENABLE_IRQ_PROFILING_HOOKS
	bool "Enable IrqEnable/Disable-Profiling"
	default n

endif
```

## drivers/char/avm_new/watchdog/Kconfig
```kconfig
config AVM_WATCHDOG
	bool "Watchdog support"
	depends on AVM_SAMMEL
	default n
	help
	  This driver provides the watchdog support.

if AVM_WATCHDOG

config AVM_WATCHDOG_STARTED_BY_FW
	bool "Hardware watchdog is started on bootup by firmware"
	default y if AVM_FASTIRQ_TZ
	help
	  If the hardware watchdog is started by the firmware and the h/w
	  sub-driver has no support for detecting that, say Y here.

config AVM_WATCHDOG_HW_STARTSTOP_SLEEPS
	bool

config AVM_WATCHDOG_PER_CPU
	bool
	default y if ARCH_QCOM || AVM_ARCH_BCM || ARCH_ECONET || \
		     AVM_ARCH_HAS_PER_CPU_WATCHDOG

config AVM_ARCH_HAS_PER_CPU_WATCHDOG
	bool

config AVM_WATCHDOG_SHIM
	bool "Watchdog driver shim for standard watchdog drivers"
	depends on AVM_WATCHDOG_SHIM_SUPPORT
	select AVM_WATCHDOG_HW_STARTSTOP_SLEEPS
	help
	  This watchdog sub-driver adds support for attaching the AVM ar7
	  watchdog driver to any standard watchdog device driver supported by
	  the watchdog core.

config AVM_WATCHDOG_SHIM_LOCKUP_PANIC
	bool "Panic on lockups"
	default y
	depends on AVM_WATCHDOG_SHIM
	help
	  Panic when the watchdog shim driver detects a lockup.  The driver
	  will trigger backtraces on all cpus before doing so.

	  Say Y here unless the kernel does the backtracing on its own, e.g.
	  when the machine dies.

config AVM_LOCKUP_DETECTOR
	bool "NMI timer based lockup detector"
	depends on AVM_WATCHDOG_SHIM
	help
	  Let the shim driver do lockup detection in the NMI handler, assuming
	  the NMI is triggered periodically.

	  Enable this if the watchdog device on the system does not support
	  triggering an NMI, but an NMI-capable timer is available. It is up
	  to the platform kernel to setup such a timer.

if !AVM_WATCHDOG_SHIM
config AVM_WATCHDOG_GRX500
	def_bool y
	depends on LANTIQ && SOC_GRX500
	select AVM_ARCH_HAS_PER_CPU_WATCHDOG
config AVM_WATCHDOG_IFXMIPS
	def_bool y
	depends on LANTIQ && !SOC_GRX500
endif

endif
```

## drivers/char/avm_power/Kconfig
```kconfig
#
# AVM Powermanagment
#
#
#
menu "AVM Powermanagment"

config AVM_POWER
	bool "AVM power managment support"
	default n
	help
	  This driver provides power managment functions for AVMs own drivers. Allow to set(and get) relevant power,bitfile,eth and other control-states.

config AVM_POWERMETER
	bool "AVM powermeter support"
	depends on AVM_POWER
	default y
	help
      This driver provides power managment ressource info function for AVMs own drivers. Collect dsl,temperature,power,idle,eth,usb,memory-state and send avm_events.

config AVM_SOFTIRQ_STATISTIC
	bool "AVM Softirq statistic for system-load"
	depends on AVM_POWER
	default n
	help
	  deliver softirq-runtime for system-load

config AVM_POWER_REMOTE_SOURCE
	bool "Powermanagment Remote-Source"
	depends on AVM_POWER && ( AVM_EVENTNODE_PUMA6 || AVM_EVENTNODE_PUMA7)
	default n
	help
	  This powermanager service send messages to other cpu

config AVM_POWER_REMOTE_SINK
	bool "Powermanagment Remote-Sink"
	depends on AVM_POWER && ( AVM_EVENTNODE_PUMA6 || AVM_EVENTNODE_PUMA7)
	default n
	help
	  This powermanager service receive messages from other cpu


config AVM_DECT_SYNC
	int "AVM dect sync support"
	depends on AVM_POWER && AVM_DECT_IO && MIPS_UR8
	default -1
	help
      Zerberus - obsolet
	  the number of gpio for sync-usage, -1: ignore sync

endmenu
```

## drivers/char/tffs/Kconfig
```kconfig
#
# TFFS configuration
#

menu "TFFS"

config TFFS
	select ZLIB_INFLATE
	select ZLIB_DEFLATE
	select AVM_EFIVAR if X86_PUMA7
	bool "AVM (T)iny (F)lash (F)ile (S)ystem"
	default y

if TFFS

config TFFS_DEV_LEGACY
	bool "Enable support for legacy TFFS v2 format"
	default y

config TFFS_DEV_MTDNAND
	bool "Enable support for NAND MTD as TFFS backing device"
	default y

config TFFS_NAND_V31
	bool "Enable support for NAND entry format version 3.1"
	default n
	depends on TFFS_DEV_MTDNAND

config TFFS_DEV_CACHE
	bool "Enable support for full TFFS RAM caching module"
	default y

config TFFS_DEV_CACHE_ENV_ONLY
	bool "Cache only bootloader environment"
	default y
	depends on TFFS_DEV_CACHE

config TFFS_DEV_CACHE_RAMONLY
	bool "Enable volatile dummy TFFS in RAM"
	default n
	depends on TFFS_DEV_CACHE
	help
    	If no flash backend is found, simulate it in RAM. Only useful
    	for bringing up new boards without working flash driver.
    	Say N unless you really, really need this.

if AVM_EFIVAR
choice
	prompt "EFI variable backend"
	optional
	default TFFS_EFI_SYNC if X86_PUMA7
	help
		Save TFFS environment in EFI variables. This is only required on x86
		platforms where the urlader does not save its environment to the TFFS.

config TFFS_DEV_EFI
	bool "Store TFFS environment as EFI variables"

config TFFS_EFI_SYNC
	bool "Sync TFFS environment to EFI variables"
endchoice
endif

comment "TFFS EFI variable support requires CONFIG_AVM_EFIVAR"
	depends on EFI && !AVM_EFIVAR

#config TFFS_DEV_MTDNOR
#	bool "Enable support for NOR MTD as TFFS backing device"
#	default y

#config TFFS_DEV_BDEV
#	bool "Enable support for block device as TFFS backing device"
#	default n

config TFFS_DEV_REMOTE
	bool "Enable support for accessing TFFS on remote event node"
	default n
	depends on AVM_EVENT_20 && (AVM_EVENTNODE_PUMA6 || AVM_EVENTNODE_PUMA7)
    
config AVM_TFFS_REMOTE_RESET_STATUS_HACK
	bool "Set AVM reboot_status when remote tffs panic log is written"
	default n
	depends on TFFS_DEV_REMOTE && MACH_PUMA7
	help
	  If a paniclog is written per remote tffs, automatically set the AVM
	  reset status to "panic".  This guarantees that if e.g. a hardware
	  watchdog resets the system after the panic, the error condition is
	  present in the AVM reset status and will be detected when rebooting.

config TFFS_DEV_REMOTE_LIMITED
	bool "Limit remote write access to bootloader environment"
	default y
	depends on TFFS_DEV_REMOTE
    
config TFFS_MTD_DEVICE_0
	int "MTD partition used for first TFFS buffer"
	default 3
	depends on TFFS_DEV_LEGACY

config TFFS_MTD_DEVICE_1
	int "MTD partition used for second TFFS buffer"
	default 4
	depends on TFFS_DEV_LEGACY

config TFFS_ENV
	depends on TFFS
	bool "AVM TFFS Environment support"
	default y

config TFFS_VERIFY_WRITE
	depends on TFFS_DEV_LEGACY || TFFS_NAND_V31
	bool "Verify entry after write"
	default n
	
config TFFS_PANIC_LOG
	bool "Enable TFFS Panic Log"

config TFFS_PANIC_LOG_ID
	int "TFFS ID for TFFS panic log"
	depends on TFFS_PANIC_LOG

config TFFS_DEBUGFS
	bool "Enable TFFS debugfs interface"
	depends on DEBUG_FS
	default n

#config TFFS_CRYPT
#	bool "AVM TFFS crypt support"
#	default y

endif

endmenu
```

## drivers/isdn/capi_oslib/Kconfig
```kconfig
#
# AVM CAPI-OSLIB
#

menu "AVM CAPI-OSLIB"

config CAPI_AVM
	bool

config CAPI_OSLIB
	tristate "split CAPI2.0 oslib"
	depends on ISDN
	select CAPI_AVM
	help
        split oslib for fbox isdn drivers

config CAPI_OSLIB_DEBUG
    bool "capi oslib debug version"
    depends on CAPI_OSLIB
	help
        debug version of capi-oslib

endmenu
```
