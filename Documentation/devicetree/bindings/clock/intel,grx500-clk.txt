## Documentation/devicetree/bindings/clock/intel,grx500-clk.txt
```
Device Tree Clock bindings for grx500 PLL controller.

This binding uses the common clock binding:
	Documentation/devicetree/bindings/clock/clock-bindings.txt

The grx500 clock controller supplies clock to various controllers within the
SoC.

Required properties for clock node
- compatible: Should be "intel,grx500-cgu".
- reg: physical base address of the controller and length of memory range.
- #clock-cells: should be 1.

Optional Propteries:
- intel,osc-frequency: frequency of the osc clock.
if missing, driver will use clock rate defined in the driver.

Example: Clock controller node:

	cgu: cgu@16200000 {
                compatible = "intel,grx500-cgu", "syscon";
		reg = <0x16200000 0x200>;
		#clock-cells = <1>;
	};


Example: UART controller node that consumes the clock generated by clock
	controller.

	asc0: serial@16600000 {
		compatible = "lantiq,asc";
		reg = <0x16600000 0x100000>;
		interrupt-parent = <&gic>;
		interrupts = <GIC_SHARED 103 IRQ_TYPE_LEVEL_HIGH>,
			<GIC_SHARED 105 IRQ_TYPE_LEVEL_HIGH>,
			<GIC_SHARED 106 IRQ_TYPE_LEVEL_HIGH>;
		clocks = <&cgu CLK_SSX4>, <&cgu GCLK_UART>;
		clock-names = "freq", "asc";
	};
```

## Documentation/devicetree/bindings/mips/intel.txt
```
Intel MIPS SoC device tree bindings

1, SoCs

Each device tree must specify a compatible value for the Intel SoC
it uses in the compatible property of the root node. The compatible
value must be one of the following values:

  intel,xrx500

2, Boards

Each device tree must specify a compatible value for the Intel Board
it uses in the compatible property of the root node. The compatible
value must be one of the following values:

  intel,easy350-anywan
```

## Documentation/devicetree/bindings/net/intel,falconmx-bm.txt
```
Intel FALCON-MX BM driver Device Tree Bindings
-------------------------------------------------------------

 - compatible:          "intel,falconmx-bm"
 - reg:                 TODO:

Examples:

bm@0 {
        compatible = "intel,falconmx-bm";
        reg = <0x00>;
};
```

## arch/mips/configs/falconmx_bootcore_defconfig
```kconfig
CONFIG_LANTIQ=y
CONFIG_SOC_FALCONMX_BOOTCORE=y
CONFIG_DT_FALCONMX_SFU_BOOTCORE=y
CONFIG_CPU_MIPS32_R2=y
# CONFIG_COMPACTION is not set
# CONFIG_SECCOMP is not set
CONFIG_MIPS_RAW_APPENDED_DTB=y
CONFIG_MIPS_CMDLINE_FROM_BOOTLOADER=y
CONFIG_SYSVIPC=y
# CONFIG_FHANDLE is not set
CONFIG_HIGH_RES_TIMERS=y
CONFIG_RCU_EXPERT=y
CONFIG_BLK_DEV_INITRD=y
# CONFIG_RD_GZIP is not set
# CONFIG_RD_BZIP2 is not set
# CONFIG_RD_LZMA is not set
# CONFIG_RD_LZO is not set
# CONFIG_RD_LZ4 is not set
CONFIG_CC_OPTIMIZE_FOR_SIZE=y
CONFIG_BPF_SYSCALL=y
# CONFIG_AIO is not set
CONFIG_EMBEDDED=y
CONFIG_SLAB_FREELIST_RANDOM=y
CONFIG_MODULES=y
CONFIG_MODULE_UNLOAD=y
# CONFIG_BLOCK is not set
# CONFIG_SUSPEND is not set
CONFIG_NET=y
CONFIG_UNIX=y
CONFIG_NETFILTER=y
# CONFIG_NETFILTER_ADVANCED is not set
CONFIG_NETLINK_DIAG=y
CONFIG_UEVENT_HELPER_PATH="/sbin/hotplug"
# CONFIG_FIRMWARE_IN_KERNEL is not set
CONFIG_FW_LOADER_USER_HELPER_FALLBACK=y
CONFIG_NETDEVICES=y
CONFIG_NET_VENDOR_AURORA=y
CONFIG_PHYLIB=y
# CONFIG_WLAN_VENDOR_ADMTEK is not set
# CONFIG_WLAN_VENDOR_ATH is not set
# CONFIG_WLAN_VENDOR_ATMEL is not set
# CONFIG_WLAN_VENDOR_BROADCOM is not set
# CONFIG_WLAN_VENDOR_CISCO is not set
# CONFIG_WLAN_VENDOR_INTEL is not set
# CONFIG_WLAN_VENDOR_INTERSIL is not set
# CONFIG_WLAN_VENDOR_MARVELL is not set
# CONFIG_WLAN_VENDOR_MEDIATEK is not set
# CONFIG_WLAN_VENDOR_RALINK is not set
# CONFIG_WLAN_VENDOR_REALTEK is not set
# CONFIG_WLAN_VENDOR_RSI is not set
# CONFIG_WLAN_VENDOR_ST is not set
# CONFIG_WLAN_VENDOR_TI is not set
# CONFIG_WLAN_VENDOR_ZYDAS is not set
CONFIG_ISDN=y
# CONFIG_INPUT is not set
CONFIG_SERIO_LIBPS2=y
# CONFIG_VT is not set
# CONFIG_UNIX98_PTYS is not set
# CONFIG_LEGACY_PTYS is not set
CONFIG_SERIAL_GRX500_BOOTCORE_CONSOLE=y
# CONFIG_HW_RANDOM is not set
# CONFIG_LTQ_VOIP_TIMER is not set
# CONFIG_LTQ_MPS2 is not set
CONFIG_GPIO_SYSFS=y
# CONFIG_HWMON is not set
# CONFIG_USB_SUPPORT is not set
# CONFIG_MIPS_PLATFORM_DEVICES is not set
# CONFIG_IOMMU_SUPPORT is not set
# CONFIG_DNOTIFY is not set
CONFIG_OVERLAY_FS=y
CONFIG_TMPFS=y
CONFIG_TMPFS_XATTR=y
CONFIG_PRINTK_TIME=y
CONFIG_DEBUG_INFO=y
# CONFIG_ENABLE_MUST_CHECK is not set
CONFIG_STRIP_ASM_SYMS=y
CONFIG_DEBUG_FS=y
CONFIG_MAGIC_SYSRQ=y
CONFIG_PANIC_ON_OOPS=y
# CONFIG_FTRACE is not set
# CONFIG_EARLY_PRINTK is not set
```

## drivers/clk/intel/Kconfig
```kconfig
# SPDX-License-Identifier: GPL-2.0
config INTEL_CGU_CLK
	depends on COMMON_CLK
	depends on INTEL_MIPS || COMPILE_TEST
	select MFD_SYSCON
	bool "Intel clock controller support"
	help
	  This driver support Intel CGU (Clock Generation Unit).

choice
	prompt "SoC platform selection"
	depends on INTEL_CGU_CLK
	default INTEL_GRX500_CGU_CLK

config INTEL_GRX500_CGU_CLK
	bool "GRX500 CLK"
	help
	  Clock driver of GRX500 platform.

endchoice
```

## drivers/net/ethernet/lantiq/cqm/Kconfig
```kconfig
#
# Central QOS Manager(CQM) configuration
#
config LTQ_CBM
	bool "Central Buffer Manager Driver"
	depends on SOC_GRX500
	default n

	---help---
	Turn on this option to enable CBM/CQM driver which is a special hardware
	present in the XRX500/FALCONMX series of SoCs to manage the network buffers
	in HW.

choice
	prompt "SoC platform selection"
	depends on LTQ_CBM

config FALCONMX_CQM
	bool "FALCONMX"
	help
	  CQM driver for FALCONMX platform.
if FALCONMX_CQM
source "drivers/net/ethernet/lantiq/cqm/falconmx/Kconfig"
endif

config GRX500_CBM
	bool "GRX500"

	help
	  CBM driver for GRX500 platform.
if GRX500_CBM
source "drivers/net/ethernet/lantiq/cqm/grx500/Kconfig"
endif
endchoice
```

## drivers/net/ethernet/lantiq/datapath/Kconfig
```kconfig
#
# Datapath Lib
#
menuconfig LTQ_DATAPATH
	bool "Datapath LIB"
	default y
	depends on LTQ_CBM
	---help---
	  Datapath Lib is to provide common rx/tx wrapper Lib without taking
	  care of much HW knowledge and also provide common interface for legacy
	  devices and different HW like to CBM or LRO.
	  Take note: All devices need to register to datapath Lib first

if LTQ_DATAPATH
config LTQ_DATAPATH_ACA_CSUM_WORKAROUND
	bool "ACA Checksum Workaround"
	default n
	depends on SOC_GRX500 && LTQ_DATAPATH
	---help---
	  It is to solve system bus hang hang issue in GRX500
	  Once there is SW-UMT, there is no need to enable it
	  in Facon-MX and later SOC, HW bug is fixed already
	  So it should be disabled

config LTQ_DATAPATH_MANUAL_PARSE
	bool "Datapath manual parse network protocol"
	depends on LTQ_DATAPATH
	default y
	---help---
	  Manual parse network protocol for tcp offloading
	  Only support limited tunnel yet
	  later need to enhance to support other tunnels
	  Also need to study to use network stack information

config LTQ_DATAPATH_COPY_LINEAR_BUF_ONLY
	bool "Datapath Copy linear buffer only for skb"
	default n
	depends on LTQ_DATAPATH
	---help---
	  Datapath Copy linear buffer only for skb if need to alloc new buffer.
	  For TSO/GSO case, it will not consider
	  Make sure TSO/GSO always with enough header room to insert pmac header
	  need to enhance in the future

config LTQ_DATAPATH_DBG
	bool "Datapath Debug Tool"
	default y
	depends on LTQ_DATAPATH
	---help---
	  Datapath Debug Tool is used to provide simple debug tool
	  All other debug tools is based on it
	  Once it is disabled, all other datapath debug tool disabled.
	  By default had better enable it

config LTQ_DATAPATH_DBG_PROTOCOL_PARSE
	bool "Datapath Debug Tool for hw checksum's protocol parsing"
	default n
	depends on LTQ_DATAPATH_DBG
	---help---
	  Datapath Debug Tool for hw checksum's protocol parsing
	  Only for debugging purpose
	  By default it should be disabled.
config LTQ_DATAPATH_EXTRA_DEBUG
	bool "extra debugging support"
	default n
	depends on  LTQ_DATAPATH_DBG
	---help---
	  This is to enable/disable extra strict debugging support.
	  This is useful during initial system bring up
	  It will affect performance
	  By default it should be disabled.

config LTQ_DATAPATH_SWDEV_TEST
	bool "Test Switchdev Event"
	default n
	depends on  LTQ_DATAPATH_DBG && LTQ_DATAPATH_SWITCHDEV
	---help---
	  This is to force enable macro CONFIG_SOC_SWITCHDEV_TESTING
	  in order to test switchdev event
	  without real switchdev handling

config LTQ_DATAPATH_SKB
	bool "Datapath Skb Hack"
	default n
	depends on  LTQ_DATAPATH
	---help---
	  For Ethernet OAM and MPE FW purpose testing purpose,
	  It needs to hack SKB

config LTQ_DATAPATH_MPE_FASTHOOK_TEST
	bool "MPE Fast Hook Test"
	default n
	depends on  LTQ_DATAPATH_SKB
	---help---
	  MPE FW Fast Hook is used to quick verify MPE FW Functionality without
	  full PPA support. Once it is enabled, it will add some fields in skb structure
	  in order to support MPE FAST HOOK. The reason is that some network driver is
	  pre-build out of this build system.
	  The testing code by default is not checked in.

config LTQ_DATAPATH_ETH_OAM
	bool "ETH OAM SUPPORT"
	default n
	depends on  LTQ_DATAPATH_SKB
	---help---
	  Datapath Ethernet OAM support. Once it is enabled, it will add some fields in skb structure
	  in order to support MPE FAST HOOK. The reason is that some network driver is
	  pre-build out of this build system.
	  The testing code by default is not checked in.

config LTQ_DATAPATH_SWITCHDEV
	bool "Switchdev Support"
	default n
	depends on  LTQ_DATAPATH && NET_SWITCHDEV
	---help---
	  Switchdev support for different switch in datapath

config LTQ_DATAPATH_PTP1588
	bool "PTP1588 Support"
	default n
	depends on  LTQ_DATAPATH
	---help---
	  PTP1588 support in datapath

config LTQ_DATAPATH_PTP1588_SW_WORKAROUND
        bool "PTP1588 Software Workaround"
        default n
        depends on  LTQ_DATAPATH && LTQ_DATAPATH_PTP1588
        ---help---
          PTP1588 Software Workaround

config LTQ_DATAPATH_DDR_SIMULATE_GSWIP31
	bool "Force FALCON-MX SOC"
	default n
	depends on LTQ_DATAPATH
	---help---
	  test falcon-mx HAL in GRX350 boards
source "drivers/net/ethernet/lantiq/datapath/gswip31/Kconfig"
source "drivers/net/ethernet/lantiq/datapath/gswip30/Kconfig"
endif
```

## drivers/net/ethernet/lantiq/datapath/gswip30/Kconfig
```kconfig
menuconfig LTQ_DATAPATH_HAL_GSWIP30
	bool "Datapath HAL_GSWIP30"
	default y
	depends on LTQ_DATAPATH && GRX500_CBM
	---help---
	  Datapath Lib is to provide common rx/tx wrapper Lib without taking
	  care of much HW knowledge and also provide common interface for legacy
	  devices and different HW like to CBM or LRO.
	  Take note: All devices need to register to datapath Lib first

if LTQ_DATAPATH_HAL_GSWIP30
config LTQ_DATAPATH_HAL_GSWIP30_MIB
	bool "Datapath aggregated mib support"
	depends on LTQ_DATAPATH_HAL_GSWIP30 && SOC_GRX500 && LTQ_TMU && LTQ_PPA_TMU_MIB_SUPPORT
	default y
	---help---
	  It is to aggregate GSWIP-L/R, TMU and driver's MIB counter

config LTQ_DATAPATH_HAL_GSWIP30_CPUFREQ
	bool "Datapath DFS(COC) support"
	depends on LTQ_DATAPATH && LTQ_CPUFREQ && LTQ_ETHSW_API
	default y
	---help---
	  It is to support DFS(COC) in Datapath
endif
```

## drivers/net/ethernet/lantiq/datapath/gswip31/Kconfig
```kconfig
menuconfig LTQ_DATAPATH_HAL_GSWIP31
	bool "Datapath HAL_GSWIP31"
	default y
	depends on LTQ_DATAPATH && FALCONMX_CQM
	---help---
	  Datapath Lib is to provide common rx/tx wrapper Lib without taking
	  care of much HW knowledge and also provide common interface for legacy
	  devices and different HW like to CBM or LRO.
	  Take note: All devices need to register to datapath Lib first

if LTQ_DATAPATH_HAL_GSWIP31
config LTQ_DATAPATH_HAL_GSWIP31_MIB
	bool "Datapath aggregated mib support"
	depends on LTQ_DATAPATH_HAL_GSWIP30 && SOC_GRX500 && LTQ_TMU && LTQ_PPA_TMU_MIB_SUPPORT
	default y
	---help---
	  It is to aggregate GSWIP-L/R, TMU and driver's MIB counter

config LTQ_DATAPATH_HAL_GSWIP30_CPUFREQ
	bool "Datapath DFS(COC) support"
	depends on LTQ_DATAPATH && LTQ_CPUFREQ && LTQ_ETHSW_API
	default y
	---help---
	  It is to support DFS(COC) in Datapath

config LTQ_DATAPATH_DDR_SIMULATE_GSWIP31
	bool "Datapath Simulation GSWIP3.1 based on GRX500 board"
	default n
	depends on LTQ_DATAPATH_DBG
	---help---
		Datapath Debug Tool for GSWIP DDR simulation
		Only for debugging purpose
		By default it should be disabled.

config LTQ_DATAPATH_DUMMY_QOS
	bool "datapath dummy QOS based on slim QOS driver or real QOS API with falcon_test API"
	default y
	depends on LTQ_PPV4_QOS_SLIM || (LTQ_PPV4_QOS || LTQ_PPV4)

config LTQ_DATAPATH_DUMMY_QOS_VIA_FALCON_TEST
	bool "datapath dummy QOS via ppv4 qos driver's falcon_test api, like slim driver"
	default y
	depends on (LTQ_PPV4_QOS || LTQ_PPV4) && !LTQ_PPV4_QOS_SLIM && LTQ_DATAPATH_DUMMY_QOS

config LTQ_DATAPATH_QOS_HAL
	bool "datapath QOS hal"
	default n
	depends on (LTQ_PPV4_QOS || LTQ_PPV4) && !LTQ_DATAPATH_DUMMY_QOS_VIA_FALCON_TEST
endif
```

## drivers/net/ethernet/lantiq/ppa/Kconfig
```kconfig
menu "PPA"

config PPA
        bool "Protocol Processing Accelerator"
        depends on LANTIQ
        default n
        ---help---
        Protocol Acceleration Engine

if PPA 

config PPA_HAL_SELECTOR
       bool "PPA HAL selector"
       depends on PPA && SOC_GRX500 
       default n
       ---help---	
       PPA hal selection logic enable

config PPA_QOS
       bool "PPA Quality of Service"
       depends on PPA 
       default y
       ---help---	
       PPA QoS enable

config PPA_API_DIRECTPATH
        bool "Direct Path Support for PPA API"
        depends on PPA
        default y
        ---help---
        Direct Path Support (e.g. WLAN) for PPA API

config PPA_API_DIRECTCONNECT
        bool "Direct connect Support for SOC"
        depends on PPA && SOC_GRX500
        default n
        ---help---
        Direct connect Support (e.g. WLAN) for PPA

config PPA_API_SW_FASTPATH
       bool "PPA software acceleration"
       depends on PPA
       default y
       ---help---       
       PPA software acceleration enable

config PPA_TCP_LITEPATH
       bool "TCP litepath"
       depends on PPA_API_SW_FASTPATH
       default y
       ---help---       
       PPA local TCP session Acceleration

config PPA_TMU_MIB_SUPPORT
        tristate "PPA TMU HAL - kernel APIs"
        depends on PPA && SOC_GRX500
        default y
        help
            TMU HAL MIB APIs support

config PPA_BR_SESS_LEARNING
        bool "Bridge session learning"
        depends on PPA
        default n
        help
            Bridge session learning support for PPA

config PPA_MPE_IP97
         tristate "INTEL PPA MPE IP97 Support"
         depends on PPA && SOC_GRX500
         default n
         help
            INTEL PPA MPE IP97 Support

endif # PPA
endmenu
```

## net/mcast_helper/Kconfig
```kconfig
#
# mcast_helper configuration
#

config MCAST_HELPER
	tristate "Multicast Helper support"
	default n 
	help
	  mcast_helper support

config MCAST_HELPER_ACL
	tristate "Multicast Helper ACL support"
	default n 
	help
	  mcast_helper ACL support
	
config MCAST_HELPER_M2U
	tristate "Multicast Helper multicast to unicast support"
	default n
	help
	  mcast_helper update multicast to unicast support
```
