## Documentation/devicetree/bindings/nvmem/layouts/amit,psection.yaml
```yaml
# SPDX-License-Identifier: (GPL-2.0-only OR BSD-2-Clause)
%YAML 1.2
---
$id: http://devicetree.org/schemas/nvmem/layouts/amit,psection.yaml#
$schema: http://devicetree.org/meta-schemas/core.yaml#

title: NVMEM layout of the AMIT P-section

maintainers:
  - Christian Schmidbauer <opensource@grische.xyz>

description:
  Devices built by AMIT, for example the D-Link AQUILA PRO AI M60, keep
  their factory data in a flash partition that the vendor firmware calls
  the P-section. The P-section starts with a 16-byte section tag and a
  16-byte CSXF header, followed by a list of records. Each record consists
  of a 32-bit ID (CSID), a 16-bit size and the data. The records have
  different sizes, so the position of a value is not fixed and has to be
  found by its CSID.

select: false

properties:
  compatible:
    const: amit,psection

  base-mac-address:
    type: object
    description:
      Base MAC address of the device, stored as 6 bytes in the record with
      CSID 0x80004230. The argument of the cell is an offset that is added
      to the address.

    properties:
      "#nvmem-cell-cells":
        const: 1

    additionalProperties: false

required:
  - compatible

additionalProperties: false

examples:
  - |
    partitions {
        compatible = "fixed-partitions";
        #address-cells = <1>;
        #size-cells = <1>;

        partition@6980000 {
            label = "Odm";
            reg = <0x6980000 0x40000>;
            read-only;

            nvmem-layout {
                compatible = "amit,psection";

                base-mac-address {
                    #nvmem-cell-cells = <1>;
                };
            };
        };
    };
...
```
