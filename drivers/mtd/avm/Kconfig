## drivers/mtd/avm/Kconfig
```kconfig
config AVM_MTDRAM_KSEG0
	bool "Assume that mtdram-adresses are kseg0-adresses instead of physical"
	help
	  Select this if the urlader provides KSEG0-addresses in the mtdram1-cmdline argument.
```

## drivers/net/datapath/dpm/gswip30/Kconfig
```kconfig
menuconfig INTEL_DATAPATH_HAL_GSWIP30
	bool "Datapath HAL_GSWIP30"
	default y
	depends on INTEL_DATAPATH && GRX500_CBM
	select INTEL_DATAPATH_HAL_GSWIP30_MIB if SOC_GRX500 && LTQ_TMU && INTEL_DATAPATH_MIB
	---help---
	  Datapath Lib is to provide common rx/tx wrapper Lib without taking
	  care of much HW knowledge and also provide common interface for legacy
	  devices and different HW like to CBM or LRO.
	  Take note: All devices need to register to datapath Lib first

if INTEL_DATAPATH_HAL_GSWIP30
config INTEL_DATAPATH_HAL_GSWIP30_MIB
	bool
	depends on SOC_GRX500 && LTQ_TMU && INTEL_DATAPATH_MIB
	---help---
	  It is to aggregate GSWIP-L/R, TMU and driver's MIB counter

config INTEL_DATAPATH_MIB_TMU_MPE_MIB
        bool "Support TMU-HAL mib API and MPE_HAL mib API"
        default n
        depends on INTEL_DATAPATH_HAL_GSWIP30_MIB && PPA_TMU_MIB_SUPPORT
        ---help---
          It is to provide TMU HAL mib api
endif
```

## drivers/net/datapath/dpm/gswip31/Kconfig
```kconfig
menuconfig INTEL_DATAPATH_HAL_GSWIP31
	bool "Datapath HAL_GSWIP31"
	default y
	depends on INTEL_DATAPATH && PRX300_CQM
	select INTEL_DATAPATH_HAL_GSWIP31_MIB if SOC_GRX500 && LTQ_TMU && LTQ_PPA_TMU_MIB_SUPPORT
	---help---
	  Datapath Lib is to provide common rx/tx wrapper Lib without taking
	  care of much HW knowledge and also provide common interface for legacy
	  devices and different HW like to CBM or LRO.
	  Take note: All devices need to register to datapath Lib first

if INTEL_DATAPATH_HAL_GSWIP31
config INTEL_DATAPATH_HAL_GSWIP31_MIB
	bool
	depends on SOC_GRX500 && LTQ_TMU && LTQ_PPA_TMU_MIB_SUPPORT
	---help---
	  It is to aggregate GSWIP-L/R, TMU and driver's MIB counter

config INTEL_DATAPATH_QOS_HAL
	bool "datapath QOS hal"
	default y
	depends on PPV4
endif
```

## drivers/net/datapath/pon_qos/Kconfig
```kconfig
# SPDX-License-Identifier: GPL-2.0

config PON_QOS
	tristate "PON QoS driver"
	depends on INTEL_DATAPATH

	help
	  This driver provides user space API for configuring PON specific QoS
	  resources as schedulers, queues etc. The interface is based on linux
	  tc offload interface. The Intel datapath driver is used to do the
	  actual hardware configuration.
```

## drivers/net/ethernet/lantiq/switch-api/Kconfig
```kconfig
# SPDX-License-Identifier: GPL-2.0-only

config INTEL_XRX500_GSWIP_API
	tristate "Intel xRX500 GSWIP-3.x register-access HAL"
	depends on INTEL_XRX500_NET
	#
	# The netdev driver ships inside this composite and reaches its
	# ports through PHYLINK.
	#
	select PHYLINK
	default n
	help
	  Passive register-access HAL for the Intel xRX500 (GRX350-class)
	  GSWIP-3.x switch core. This module binds two SoC-scope platform
	  devices (gswip@1c000000 and gswip@1a000000), ioremaps their
	  register windows, and exposes the four word/field accessors used
	  by higher-level GSWIP feature drivers. It performs no PCE
	  microcode load, no switch soft-reset toggle, no PHY/MDIO
	  bring-up, no clock/reset gating, and no interrupt wiring.

	  To compile this driver as a module, choose M here. The module
	  will be called intel-xrx500-gswip.

config INTEL_XRX500_MDIO
	tristate "Intel xRX500 GPHY firmware loader"
	depends on INTEL_XRX500_GSWIP_API
	select FW_LOADER
	select RESET_CONTROLLER
	default n
	help
	  Loader for the firmware the integrated Gigabit PHYs run. The
	  firmware is proprietary and is not carried in the kernel tree,
	  so build this as a module (M) and let it read the blob from
	  /lib/firmware; built in, it has to reach the firmware before any
	  filesystem is mounted.

	  To compile this driver as a module, choose M here. The module
	  will be called intel-xrx500-mdio.
```

## drivers/net/ppv4/Kconfig
```kconfig
#
# PPV4 configuration
#
config PPV4
	tristate "Packet Processor V4"

	---help---
	  Packet Processor V4 Driver

config PPV4_LGM
	bool "Packet Processor V4 for LGM"
	depends on PPV4
	---help---
	  Packet Processor V4 Driver for LGM

config PPV4_UT
	bool "Packet Processor V4 Unit test"
	depends on PPV4
	---help---
	  Packet Processor V4 Driver Unit Test
```

## drivers/phy/intel/Kconfig
```kconfig
# SPDX-License-Identifier: GPL-2.0
#
# Phy drivers for Intel platforms
#
config PHY_INTEL_GRX500_PCIE
	tristate "Intel GRX500 PCIe slim PHY driver"
	depends on INTEL_MIPS || COMPILE_TEST
	depends on OF && HAS_IOMEM
	select GENERIC_PHY
	select MFD_SYSCON
	select RESET_CONTROLLER
	help
	  Enable this to support the PCIe slim PHY that feeds the on-chip
	  PCIe host bridges of the Intel MIPS (xRX500/GRX500) SoC family.
	  Besides its own PDI register block the driver drives the shared
	  LCPLL spread-spectrum generator in the CGU and the per-instance
	  reference clock gate in the chip-top interface mux.

	  To compile this driver as a module, choose M here: the module
	  will be called phy-intel-grx500-pcie.ko.

config PHY_INTEL_GRX500_USB
	tristate "Intel GRX500 USB PHY driver"
	depends on INTEL_MIPS || COMPILE_TEST
	depends on OF && HAS_IOMEM
	select GENERIC_PHY
	select MFD_SYSCON
	select RESET_CONTROLLER
	select RESET_LANTIQ
	help
	  Enable this to support the USB PHYs that feed the on-chip DWC3
	  controllers of the Intel MIPS (xRX500/GRX500) SoC family. Besides
	  its own gate clock, reset line and optional VBUS supply the driver
	  owns the AXI endianness field its controller needs in the chip-top
	  syscon, which on this big-endian SoC has to be set before the
	  controller does any DMA.

	  To compile this driver as a module, choose M here: the module
	  will be called phy-intel-grx500-usb.ko.

config PHY_INTEL_KEEMBAY_EMMC
	tristate "Intel Keem Bay EMMC PHY driver"
	depends on ARCH_KEEMBAY || COMPILE_TEST
	depends on HAS_IOMEM
	select GENERIC_PHY
	select REGMAP_MMIO
	help
	  Choose this option if you have an Intel Keem Bay SoC.

	  To compile this driver as a module, choose M here: the module
	  will be called phy-keembay-emmc.ko.

config PHY_INTEL_KEEMBAY_USB
	tristate "Intel Keem Bay USB PHY driver"
	depends on ARCH_KEEMBAY || COMPILE_TEST
	depends on HAS_IOMEM
	select GENERIC_PHY
	select REGMAP_MMIO
	help
	  Choose this option if you have an Intel Keem Bay SoC.

	  To compile this driver as a module, choose M here: the module
	  will be called phy-keembay-usb.ko.

config PHY_INTEL_LGM_COMBO
	bool "Intel Lightning Mountain ComboPHY driver"
	depends on X86 || COMPILE_TEST
	depends on OF && HAS_IOMEM
	select MFD_SYSCON
	select GENERIC_PHY
	select REGMAP
	help
	  Enable this to support Intel ComboPhy.

	  This driver configures ComboPhy subsystem on Intel gateway
	  chipsets which provides PHYs for various controllers, EMAC,
	  SATA and PCIe.

config PHY_INTEL_LGM_EMMC
	tristate "Intel Lightning Mountain EMMC PHY driver"
	depends on X86 || COMPILE_TEST
	select GENERIC_PHY
	help
	  Enable this to support the Intel EMMC PHY
```

## fs/notify/Kconfig
```kconfig
config FSNOTIFY
	def_bool n
	select SRCU

config FSNOTIFY_RECURSIVE
	bool "Recursive FSNOTIFY support"
	depends on FSNOTIFY
	default n

source "fs/notify/dnotify/Kconfig"
source "fs/notify/inotify/Kconfig"
source "fs/notify/fanotify/Kconfig"
```

## kernel/Kconfig.avm
```kconfig
menuconfig AVM_KERNEL
	bool "AVM kernel enhancements"

if AVM_KERNEL

config AVM_ENHANCED
	bool "AVM collection of various enhanced kernel-features"
	select BUG_EXTRA_INFO if MIPS
	select AVM_PROM_ENVIRONMENT
	select AVM_RTNETLINK_ENHANCEMENT
	select AVM_NET_SKB_INPUT_DEV
	help
	  Be aware: For compatibility reasons AVM_ENHANCED currently selects a
	  list of other (smaller) AVM kernel enhancements.

config AVM_PROM_ENVIRONMENT
	bool "Enable AVM EVA prom environment support"
	select ZLIB_DEFLATE
	help
	  Adds support to access AVM's EVA environment variables.

config OF_AVM_DT
	bool "Support avm_hw_config table in device tree"
	help
	  This option enables the generation of the avm_hw_config_table out of
	  the device tree.

config OF_AVM_DT_ENV
	bool "prom_getenv reads environment from the chosen node of the device tree"
	default n
	depends on AVM_PROM_ENVIRONMENT
	help
	  This option enables the reading of the environment via prom_getenv from the
	  device tree. This option may only be enabled if the environment is passed via
	  the device tree. (e.g. 4080)

config AVM_GPIO_SHIM
	bool "AVM GPIO API"
	help
	  AVM API for accessing GPIOs and LEDs.

config AVM_GPIO_SHIM_GPIOD
	bool "Access to GPIOs"
	depends on AVM_GPIO_SHIM && GPIOLIB
	help
	  Support accessing GPIOs via the AVM GPIO API.

config AVM_GPIO_SHIM_LED
	bool "Access to LEDs"
	depends on AVM_GPIO_SHIM && LEDS_TRIGGERS
	help
	  Support accessing LEDs via the AVM GPIO API.

source "kernel/rte/Kconfig"

endif # AVM_KERNEL

config PLATFORM_WANTS_UBIK2_ISDNSTACK_ON_CPU
	int "Ask AVM ISDN-stack (ubik2) to bind itself to the given CPU"
	range 0 3
	default 0
```

## kernel/rte/Kconfig
```kconfig
config HAVE_AVM_RTE
	bool

config AVM_RTE
	bool "AVM real-time enhancements"
	depends on HAVE_AVM_RTE
	default y
	help
	 The AVM real-time enhancement (RTE) framework allows executing
	 code with low-latency requirements in high-priority interrupt
	 handlers.  On ARM, these are Fast Interrupts, on MIPS, they execute
	 as yield threads.
	 One prominent user of this is the AVM telephony stack.
```

## net/avm_pa/Kconfig
```kconfig
#
# Packet configuration
#

config AVM_PA
	bool "AVM Packet acceleration"
	depends on AVM_ENHANCED
	depends on (L2TP || L2TP=n)
	---help---
	  The AVM Packet acceleration can be used to let packets travel
	  directly from input device to output device.

	  If unsure, say N.

config AVM_PA_RPS
	bool "AVM PA Receive Packet Steering"
	depends on AVM_PA
	---help---
	  The AVM Packet acceleration can be used to let packets travel
	  directly from input device to output device.

	  If unsure, say N.

config AVM_PA_RPS_QUEUES
	int "Number of queues for RPS"
	range 2 32
	default 4
	depends on AVM_PA_RPS
	---help---
	  The number of queues for RPS. Should be larger or equal to the number of CPUs for
	  best packet distribution. Must be a power of 2. If less then the number of CPUs,
	  then higher-numbered CPUs will not be considered for RPS.

	  4 seems to be a good value for our routers. The hash function used has yet to
	  show that it gives a good distribution for larger amounts of RPS queues.

config AVM_PA_MAX_PID
	int "AVM Packet acceleration max PIDs"
	depends on AVM_PA
	range 8 256
	default 32
	---help---
	  Max number of interfaces supported by AVM_PA
	  allowed range:     8 - 256
	  reasonable range:  8 -  64

config AVM_PA_MAX_VPID
	int "AVM Packet acceleration max VPIDs"
	depends on AVM_PA
	range 8 256
	default 32
	---help---
	  Max number of virtual interfaces supported by AVM_PA
	  allowed range:     8 - 256
	  reasonable range:  8 -  64

config AVM_PA_MAX_SESSION
	int "AVM Packet acceleration max Sessions"
	depends on AVM_PA
	range 16 32678
	default 256
	---help---
	  Max number of sessions supported by AVM_PA
	  allowed range:     16 - 32678
	  reasonable range:  64 -  4096

config AVM_PA_TX_NAPI
	bool "Call tx_func via NAPI"
	depends on AVM_PA
	default n
	---help---
	  This makes AVM_PA set up a NAPI context to call the tx_func given by egress
	  devices. This can be helpful for load balancing. It is most effective on CONFIG_SMP
	  because the napi_poll function will be offloaded to a different core, thereby
	  moving distributing CPU load. If dev_queue_xmit() is called in the tx_func then
	  the entire QoS layer will be run on another core.

config AVM_PA_SCH_LLQ
	tristate "LLQ Queue (CBWFQ with strict priorities)"
	depends on NET_SCHED
	depends on !(NET_SCH_LLQ=m || NET_SCH_LLQ=y)
	depends on AVM_ENHANCED
	default m
	---help---
	  If you say Y here, you will be able to schedule packets
	  with strict priorities and weight.
	  (Class-Bases Weighted Fair Queuing with strict priorities)
	  If unsure, say Y.

	  To compile this code as a module, choose M here: the
	  module will be called sch_llq.

config AVM_PA_SCH_TACK
        tristate "Ack compression accelerator (Turbo ACK)"
        depends on NET_SCHED
        default n
        ---help---
          Say Y here if you want to use the turbo ack accelerator which
          accelerates TCP traffic by merging TCP ACK packets on egress.

          To compile this driver as a module, choose M here: the module
          will be called sch_tack.

          If unsure, say N.
```

## net/bridge/Kconfig
```kconfig
#
# 802.1d Ethernet Bridging
#

config BRIDGE
	tristate "802.1d Ethernet Bridging"
	select LLC
	select STP
	depends on IPV6 || IPV6=n
	---help---
	  If you say Y here, then your Linux box will be able to act as an
	  Ethernet bridge, which means that the different Ethernet segments it
	  is connected to will appear as one Ethernet to the participants.
	  Several such bridges can work together to create even larger
	  networks of Ethernets using the IEEE 802.1 spanning tree algorithm.
	  As this is a standard, Linux bridges will cooperate properly with
	  other third party bridge products.

	  In order to use the Ethernet bridge, you'll need the bridge
	  configuration tools; see <file:Documentation/networking/bridge.txt>
	  for location. Please read the Bridge mini-HOWTO for more
	  information.

	  If you enable iptables support along with the bridge support then you
	  turn your bridge into a bridging IP firewall.
	  iptables will then see the IP packets being bridged, so you need to
	  take this into account when setting up your firewall rules.
	  Enabling arptables support when bridging will let arptables see
	  bridged ARP traffic in the arptables FORWARD chain.

	  To compile this code as a module, choose M here: the module
	  will be called bridge.

	  If unsure, say N.

config AVM_BRIDGE_FLOOD_RATELIMITER
	bool "Port flood rate limiting"
	depends on AVM_ENHANCED
	depends on BRIDGE
	default y
	---help---
	  AVM extension

	  This enables a simple, configurable bridge flood rate limiting mechanism, to
	  help protect accidental or willful network loops. You can configure a
	  maximum packet rate and a reserve. The reserve can be higher to allow for
	  short bursts.

	  The ratelimiter will only limit packets which are forwarded on all ports.
	  Traffic (unicast and multicast) that is forwarded to specific ports is
	  unaffected. Locally generated traffic is unaffected as well. It is
	  disabled by default and must be configured through sysfs.

config BRIDGE_IGMP_SNOOPING
	bool "IGMP/MLD snooping"
	depends on BRIDGE
	depends on INET
	default y
	---help---
	  If you say Y here, then the Ethernet bridge will be able selectively
	  forward multicast traffic based on IGMP/MLD traffic received from
	  each port.

	  Say N to exclude this support and reduce the binary size.

	  If unsure, say Y.

config BRIDGE_VLAN_FILTERING
	bool "VLAN filtering"
	depends on BRIDGE
	depends on VLAN_8021Q
	default n
	---help---
	  If you say Y here, then the Ethernet bridge will be able selectively
	  receive and forward traffic based on VLAN information in the packet
	  any VLAN information configured on the bridge port or bridge device.

	  Say N to exclude this support and reduce the binary size.

	  If unsure, say Y.

config BRIDGE_DEFAULT_FDB_MAX_LEARNED
	int "Default FDB learning limit"
	default 0
	depends on BRIDGE
	help
	  Sets a default limit on the number of learned FDB entries on
	  new bridges. This limit can be overwritten via netlink on a
	  per bridge basis.

	  The default of 0 disables the limit.

	  If unsure, say 0.

config MCAST_PROXY
	tristate "MCAST Proxy support"
	depends on m
	default n
	help
	  Lantiq Multicast Proxy support

config MCAST_SNOOPING
	bool "MCAST Snooping support"
	default n
	help
	  Lantiq Multicast Snooping support
```
