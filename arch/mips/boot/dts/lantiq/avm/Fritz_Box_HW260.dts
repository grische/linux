/dts-v1/;

#include "hw260.dtsi"

/ {

    model = "AVM7583 VDSL (GRX550, HW260) Main model";

    chosen {
        //bootargs-append = "maxcpus=4 cca=5 pci=pcie_bus_perf";
    };

    avm-hw-revision{
        compatible = "avm,avm_hw_revision";
        revision = "260";
        subrevision = "0";
    };

};
