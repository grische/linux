/dts-v1/;

#include "hw221.dtsi"

/ {

    model = "AVM7560 (GRX350, HW221) Main model";

    chosen {
        //bootargs-append = "maxcpus=4 cca=5 pci=pcie_bus_perf";
    };

    avm-hw-revision{
        compatible = "avm,avm_hw_revision";
        revision = "221";
        subrevision = "0";
    };

};
