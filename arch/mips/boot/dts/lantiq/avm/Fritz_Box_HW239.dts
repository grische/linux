/dts-v1/;

#include "hw239.dtsi"

/ {

    model = "AVM7583 (GRX550, HW239) Main model";

    chosen {
        //bootargs-append = "maxcpus=4 cca=5 pci=pcie_bus_perf";
    };

    avm-hw-revision{
        compatible = "avm,avm_hw_revision";
        revision = "239";
        subrevision = "0";
    };

};
