/dts-v1/;

/*****************************************************************
** Include a chip configuration file                             
*****************************************************************/
/include/ "falconmx_bootcore.dtsi"

/ {
      model = "FALCONMX HAPS BOOTCORE (MIPS 4Kec)";

};
